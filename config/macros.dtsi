/ {
    macros {
        equals_macro: equals_macro {
            compatible = "zmk,behavior-macro";
            #binding-cells = <0>;
            wait-ms = <20>;

            bindings = < &macro_tap
                &kp AT_SIGN
                &kp O
                &kp V
                &kp E
                &kp R
                &kp R
                &kp I
                &kp D
                &kp E
                &kp ENTER
                &kp P
                &kp U
                &kp B
                &kp L
                &kp I
                &kp C
                &kp SPACE
                &kp B
                &kp O
                &kp O
                &kp L
                &kp E
                &kp A
                &kp N
                &kp SPACE
                &kp E
                &kp Q
                &kp U
                &kp A
                &kp L
                &kp S
                &kp LEFT_PARENTHESIS
                &kp O
                &kp B
                &kp J
                &kp E
                &kp C
                &kp T
                &kp SPACE
                &kp O
                &kp B
                &kp J
                &kp RIGHT_PARENTHESIS
                &kp SPACE
                &kp LEFT_BRACE
                &kp ENTER
                &kp SPACE
                &kp SPACE
                &kp SPACE
                &kp SPACE
                &kp I
                &kp F
                &kp SPACE
                &kp LEFT_PARENTHESIS
                &kp T
                &kp H
                &kp I
                &kp S
                &kp SPACE
                &kp EQUAL
                &kp EQUAL
                &kp SPACE
                &kp O
                &kp B
                &kp J
                &kp RIGHT_PARENTHESIS
                &kp SPACE
                &kp R
                &kp E
                &kp T
                &kp U
                &kp R
                &kp N
                &kp SPACE
                &kp T
                &kp R
                &kp U
                &kp E
                &kp SEMICOLON
                &kp ENTER
                &kp SPACE
                &kp SPACE
                &kp SPACE
                &kp SPACE
                &kp I
                &kp F
                &kp SPACE
                &kp LEFT_PARENTHESIS
                &kp O
                &kp B
                &kp J
                &kp SPACE
                &kp EQUAL
                &kp EQUAL
                &kp SPACE
                &kp N
                &kp U
                &kp L
                &kp L
                &kp SPACE
                &kp SPACE
                &kp G
                &kp E
                &kp T
                &kp C
                &kp L
                &kp A
                &kp S
                &kp S
                &kp LEFT_PARENTHESIS
                &kp RIGHT_PARENTHESIS
                &kp SPACE
                &kp EQUAL
                &kp SPACE
                &kp O
                &kp B
                &kp J
                &kp PERIOD
                &kp G
                &kp E
                &kp T
                &kp C
                &kp L
                &kp A
                &kp S
                &kp S
                &kp LEFT_PARENTHESIS
                &kp RIGHT_PARENTHESIS
                &kp RIGHT_PARENTHESIS
                &kp SPACE
                &kp R
                &kp E
                &kp T
                &kp U
                &kp R
                &kp N
                &kp SPACE
                &kp F
                &kp A
                &kp L
                &kp S
                &kp E
                &kp SEMICOLON
                &kp ENTER
                &kp ENTER
                &kp SPACE
                &kp SPACE
                &kp SPACE
                &kp SPACE
                &kp S
                &kp T
                &kp O
                &kp P
                &kp SPACE
                &kp S
                &kp T
                &kp O
                &kp P
                &kp SPACE
                &kp EQUAL
                &kp SPACE
                &kp LEFT_PARENTHESIS
                &kp S
                &kp T
                &kp O
                &kp P
                &kp RIGHT_PARENTHESIS
                &kp SPACE
                &kp O
                &kp B
                &kp J
                &kp SEMICOLON
                &kp ENTER
                &kp SPACE
                &kp SPACE
                &kp SPACE
                &kp SPACE
                &kp R
                &kp E
                &kp T
                &kp U
                &kp R
                &kp N
                &kp SPACE
                &kp T
                &kp H
                &kp I
                &kp S
                &kp PERIOD
                &kp Z
                &kp O
                &kp N
                &kp E
                &kp SPACE
                &kp EQUAL
                &kp EQUAL
                &kp SPACE
                &kp S
                &kp T
                &kp O
                &kp P
                &kp PERIOD
                &kp Z
                &kp O
                &kp N
                &kp E
                &kp SPACE
                &kp SPACE
                &kp T
                &kp H
                &kp I
                &kp S
                &kp PERIOD
                &kp N
                &kp A
                &kp M
                &kp E
                &kp PERIOD
                &kp E
                &kp Q
                &kp U
                &kp A
                &kp L
                &kp S
                &kp LEFT_PARENTHESIS
                &kp S
                &kp T
                &kp O
                &kp P
                &kp PERIOD
                &kp N
                &kp A
                &kp M
                &kp E
                &kp RIGHT_PARENTHESIS
                &kp SEMICOLON
                &kp ENTER
                &kp RIGHT_BRACE
                &kp ENTER
            >;
        };
    };
};
